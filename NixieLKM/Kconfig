## NixieLKM/Kconfig
```kconfig
config NIXIE_SPI
	tristate "Nixie Module"
	---help---
	  A hacky way of interfacing with an array of Nixie Tube
```

## NixieLKM/sk9822/Kconfig
```kconfig
config SK9822
	tristate "SK9822 Lighting Module"
	---help---
	  Alexa, Glow in Blue!
```
